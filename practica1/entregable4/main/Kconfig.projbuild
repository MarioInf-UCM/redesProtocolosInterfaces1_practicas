## practica1/entregable4/main/Kconfig.projbuild
```kconfig
menu "Example Configuration"

    orsource "$IDF_PATH/examples/common_components/env_caps/$IDF_TARGET/Kconfig.env_caps"

    config TIME_WAIT_TASK1
        int "Tiempo de espera para la tarea 1"
        range 1 99
        default 4
        help 
            Define el tiempo en segundos que deberá esperar la tarea 1 para volver a ejecutarse.

    config TIME_WAIT_TASK2
        int "Tiempo de espera para la tarea 2"
        range 1 99
        default 7
        help 
            Define el tiempo en segundos que deberá esperar la tarea 2 para volver a ejecutarse.

endmenu
```

## practica1/entregable5/main/Kconfig.projbuild
```kconfig
menu "Example Configuration"

    config EXAMPLE_SCAN_LIST_SIZE
        int "Max size of scan list"
        range 0 20
        default 20
        help
            The size of array that will be used to retrieve the list of access points.

endmenu
```

## practica2/entregable4y5/main/Kconfig.projbuild
```kconfig
menu "Example Configuration - Scan config"

    config EXAMPLE_SCAN_LIST_SIZE
        int "Número maximo de redes escaneadas"
        range 0 20
        default 10
        help
            Tamaño del sarray que será utilizado apra guardar la lista de puntos de acceso encontrados.
    
    choice WIFICONF_SHOW_HIDDEN
        prompt "Escaneo de redes ocultas"
        default WIFICONF_SHOW_HIDDEN_DISABLE
        help
            Indicar si se quiere obtener información también sobre las redes ocultas
        config WIFICONF_SHOW_HIDDEN_ENABLE
            bool "Habilitado"
        config WIFICONF_SHOW_HIDDEN_DISABLE
            bool "Desabilitado"
    endchoice


    config WIFICONF_CHANNEL
        int "Canal de escaneo"
        default 0
        help 
            Indique el canal en el cual quiere realziar el escaneo (0 para indicar todos los canales)-

    choice WIFICONF_SCAN_MODE
        prompt "Tipo de escaneo"
        default WIFICONF_SCAN_MODE_ACTIVE
        help
            indique el tipo de escaneo a realizar: Activo(se enviarán mensajes de aviso) o Pasivo (únicamente se esperará a la recepción de mensajes periódicos)
        config WIFICONF_SCAN_MODE_ACTIVE
            bool "Activo"
        config WIFICONF_SCAN_MODE_PASIVE
            bool "Pasivo"
    endchoice

    config WIFICONF_SCANTIME_ACTIVE_MIN
        int  "Tiempo mínimo de escaneo en el modo activo"
        range 20 60
        default 40

    config WIFICONF_SCANTIME_ACTIVE_MAX
        int  "Tiempo máximo de escaneo en el modo activo"
        range 200 20000
        default 200

    config WIFICONF_SCANTIME_PASSIVE
        int  "Tiempo de escaneo en el modo pasivo"
        range 200 20000
        default 200
        
endmenu


menu "Example Configuration - Known networks"

    config KNOWN_NETWORKS_LIST_SIZE
        int  "Número máximo de redes conocidas"
        range 1 20
        default 10

        
    config KNOWN_NETWORKS_LIST
        string "Lista de redes conocidas"
        default "RPI1_test:test1234 RPI1_2test:2test1234;"
        help
            Las redes se indcan en orden de prioridad descendente y especificadas en el siguiente formato: "SSID_1:PASS_1 SSID_2:PASS_2..."
    

    config ESP_MAXIMUM_RETRY
        int "Maximum retry"
        default 5
        help
            Número maximo de intentos apra conectarse con el Punto de Acceso conocido


    config ESP_WIFI_PW_ID
        string "PASSWORD IDENTIFIER"
        depends on  ESP_WPA3_SAE_PWE_HASH_TO_ELEMENT|| ESP_WPA3_SAE_PWE_BOTH
        default ""
        help
            password identifier for SAE H2E


    choice ESP_WIFI_SAE_MODE
        prompt "WPA3 SAE mode selection"
        default ESP_WPA3_SAE_PWE_BOTH
        help
            Select mode for SAE as Hunt and Peck, H2E or both.
        config ESP_WPA3_SAE_PWE_HUNT_AND_PECK
            bool "HUNT AND PECK"
        config ESP_WPA3_SAE_PWE_HASH_TO_ELEMENT
            bool "H2E"
        config ESP_WPA3_SAE_PWE_BOTH
            bool "BOTH"
    endchoice


    choice ESP_WIFI_SCAN_AUTH_MODE_THRESHOLD
        prompt "WiFi Scan auth mode threshold"
        default ESP_WIFI_AUTH_WPA2_PSK
        help
            The weakest authmode to accept in the scan mode.
            This value defaults to ESP_WIFI_AUTH_WPA2_PSK incase password is present and ESP_WIFI_AUTH_OPEN is used.
            Please select ESP_WIFI_AUTH_WEP/ESP_WIFI_AUTH_WPA_PSK incase AP is operating in WEP/WPA mode.

        config ESP_WIFI_AUTH_OPEN
            bool "OPEN"
        config ESP_WIFI_AUTH_WEP
            bool "WEP"
        config ESP_WIFI_AUTH_WPA_PSK
            bool "WPA PSK"
        config ESP_WIFI_AUTH_WPA2_PSK
            bool "WPA2 PSK"
        config ESP_WIFI_AUTH_WPA_WPA2_PSK
            bool "WPA/WPA2 PSK"
        config ESP_WIFI_AUTH_WPA3_PSK
            bool "WPA3 PSK"
        config ESP_WIFI_AUTH_WPA2_WPA3_PSK
            bool "WPA2/WPA3 PSK"
        config ESP_WIFI_AUTH_WAPI_PSK
            bool "WAPI PSK"
    endchoice


endmenu
```

## practica6/gatt_client/main/Kconfig.projbuild
```kconfig
menu "Client Configuration"

    config EXAMPLE_DUMP_ADV_DATA_AND_SCAN_RESP
        bool "Dump whole adv data and scan response data in example"
        default n

    config BLE_SCAN_LE_INTERVAL
        hex "Ble scan interval (Time = N * 0.625 msec Time Range: 2.5 msec to 10240 msec)"
        range 0x0004 0x4000
        default 0x1900
    
    config BLE_SCAN_LE_WINDOW
        hex "The duration of the LE scan. LE_Scan_Window shall be less than or equal to LE_Scan_Interval (Time = N * 0.625 msec Time Range: 2.5 msec to 10240 msec)"
        range 0x0004 0x4000
        default 0x0010
    
    config BLE_SCAN_DURATION
        int "Duration of a scan (s)"
        range 60 300
        default 60
    
    config BLE_SCAN_DELAY
        int "Delay before starting new scan (s)"
        range 10 600
        default 30

    config MAC_KNOWN_DEVICE
        string "MAC for a known device on advertising state"
        default "24:0a:c4:ea:28:c2"
        help
            Specify a MAC address for the ethernet interface in the form of
            six hex 8-bit chars separated by colons (e.g.:
            aa:33:cc:22:e2:c0).  The default is an empty string, which
            means the code will make 00:00:5E:00:53:XX, where XX will be
            random.
    
    config BLINK_GPIO
        int "Blink GPIO number"
        default 32
        help
            GPIO number (IOxx) to blink on and off the LED.
            Some GPIOs are used for other purposes (flash connections, etc.) and cannot be used to blink.

endmenu
```
